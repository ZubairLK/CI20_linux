## Documentation/devicetree/bindings/mfd/ingenic,jz4740-adc.txt
```
* Ingenic JZ4740/JZ4780 ADC

Required properties:
- compatible: can be "ingenic,jz4740-adc" or "ingenic,jz4780-adc"
- reg: Should contain the address & length of registers
- interrupts: Should specify the interrupt provided by parent.
- clocks: Should contain a single clock specifier for the ADC clock.
- clock-names: Should be "adc".

Example:

adc@0x10070000 {
	compatible = "ingenic,jz4740-adc";
	reg = <0x10070000 0x30>;

	interrupt-parent = <&intc>;
	interrupts = <18>;

	clocks = <&cgu JZ4780_CLK_SADC>;
	clock-names = "adc";
};
```

## Documentation/devicetree/bindings/misc/ingenic,jz4780-efuse.txt
```
Ingenic JZ4780 EFUSE driver bindings

Required properties:
- "compatible"		Must be set to "ingenic,jz4780-efuse"
- "reg"			Register location and length
- "vddq-gpio"		gpio handle for VDDQ gpio. Used for programming the efuse
- "clocks"		Handle for the ahb clock for the efuse.
- "clock-names"		Must be "ahb2"

Example:

efuse: efuse@134100D0 {
	compatible = "ingenic,jz4780-efuse";
	reg = <0x134100D0 0xFF>;

	vddq-gpio = <&gpe 4 GPIO_ACTIVE_LOW>;

	clocks = <&cgu JZ4780_CLK_AHB2>;
	clock-names = "ahb2";
};
```

## Documentation/devicetree/bindings/mtd/ingenic,jz4780-nand.txt
```
* Ingenic JZ4780 NAND/BCH

This file documents the device tree bindings for NAND flash devices on the
JZ4780. NAND devices are connected to the NEMC controller (described in
memory-controllers/ingenic,jz4780-nemc.txt), and thus NAND device nodes must
be children of the NEMC node.

Required NAND device properties:
- compatible: Should be set to "ingenic,jz4780-nand".
- reg: For each bank with a NAND chip attached, should specify a bank number,
  an offset of 0 and a size of 0x1000000 (i.e. the whole NEMC bank).

Optional NAND device properties:
- ingenic,bch-device: To make use of the hardware BCH controller, this property
  must contain a phandle for the BCH controller node. The required properties
  for this node are described below. If this is not specified, software BCH
  will be used instead.
- nand-ecc-step-size: ECC block size in bytes.
- nand-ecc-strength: ECC strength (max number of correctable bits).
- rb-gpios: GPIO specifier for the busy pin.
- wp-gpios: GPIO specifier for the write protect pin.

Example:

nemc: nemc@13410000 {
	...

	nand: nand@1 {
		compatible = "ingenic,jz4780-nand";
		reg = <1 0 0x1000000>;	/* Bank 1 */

		ingenic,bch-device = <&bch>;
		nand-ecc-step-size = <1024>;
		nand-ecc-strength = <24>;

		rb-gpios = <&gpa 20 GPIO_ACTIVE_LOW>;
		wp-gpios = <&gpf 22 GPIO_ACTIVE_LOW>;
	};
};

The BCH controller is a separate SoC component used for error correction on
NAND devices. The following is a description of the device properties for a
BCH controller.

Required BCH properties:
- compatible: Should be set to "ingenic,jz4780-bch".
- reg: Should specify the BCH controller registers location and length.
- clocks: Clock for the BCH controller.

Example:

bch: bch@134d0000 {
	compatible = "ingenic,jz4780-bch";
	reg = <0x134d0000 0x10000>;

	clocks = <&cgu JZ4780_CLK_BCH>;
};
```

## Documentation/devicetree/bindings/net/wireless/ingenic,iw810x.txt
```
* Ingenic iw810x wireless lan controller

The IW8101/8103 wireless chips embed a Broadcom BCM43362/4330 
The chip can be connected via SPI or via SDIO. 

The actual driver used for the chips is brcmfmac, this driver simply
implements helper functions for the brcmfmac driver to control power,
clock and reset for the chip.

This document describes the binding for the helper driver.

Required properties:
- compatible :        Should be "ingenic,iw810x"
- ingenic,reset-gpio : handle to gpio for reset.
- ingenic,power-gpio : handle to gpio for power
- ingenic,iw810x_32k : string for 32Khz clock provider

Example board file:
wifi: wifi {
	compatible = "ingenic,iw810x";
	ingenic,reset-gpio = <&gpf 7 0>;
	ingenic,power-gpio = <&gpb 19 0>;
	ingenic,iw810x_32k = "jz47xx-rtc32k";
};

Example soc file for sdio connectivity:

msc1: msc@13460000 {
	compatible = "ingenic,jz4780-mmc";
	reg = <0x13460000 0x1000>;

	interrupt-parent = <&intc>;
	interrupts = <36>;

	clocks = <&cgu JZ4780_CLK_MSC1>;
};
```

## arch/mips/jz4780/Kconfig
```kconfig
choice
	prompt "Machine type"
	depends on MACH_JZ4780
	default JZ4780_CI20

config JZ4780_CI20
	bool "CI20"

endchoice
```

## drivers/gpu/drm/jz4780/Kconfig
```kconfig
config DRM_JZ4780
	tristate "DRM Support for Ingenic JZ4780 LCDC Display Controller"
	depends on DRM && OF
	select DRM_KMS_HELPER
	select DRM_KMS_FB_HELPER
	select DRM_KMS_CMA_HELPER
	select DRM_GEM_CMA_HELPER
	select VIDEOMODE_HELPERS
	help
	  Choose this option if you have an Ingenic JZ4780 SoC with LCDC display
	  controller, for example the MIPS Creator CI20 board

config JZ4780_DW_HDMI
        tristate "JZ4780 specific extensions for Synopsys DW HDMI"
        depends on DRM_JZ4780
        select DRM_DW_HDMI
        help
	  This selects support for JZ4780 SoC specific extensions
	  for the Synopsys DesignWare HDMI driver. If you want to
	  enable HDMI on JZ4780 based SoC, you should select this
	  option.n if you have an Ingenic SoC with LCDC display
	  controller, for example the CI20 board
```

## drivers/misc/efuse/Kconfig
```kconfig
#
# Misc efuse devices. generally found in SoCs. Used to store mac addresses,
# encryption keys, etc.
#

menu "Efuse devices"

config JZ4780_EFUSE
	bool "Ingenic JZ4780 EFUSE driver"
	depends on MACH_JZ4780
	default n
	help
	Say Y here if you want the efuse driver for the Ingenic JZ4780 SoC.


endmenu
```
